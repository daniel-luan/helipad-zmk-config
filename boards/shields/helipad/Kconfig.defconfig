## boards/shields/helipad/Kconfig.defconfig
```kconfig
# Copyright (c) 2020 The ZMK Contributors
# SPDX-License-Identifier: MIT

if SHIELD_HELIPAD_RIGHT

config ZMK_KEYBOARD_NAME
    default "Helipad"

config ZMK_SPLIT_ROLE_CENTRAL
    default y

endif

if SHIELD_HELIPAD_LEFT || SHIELD_HELIPADX_RIGHT

config ZMK_SPLIT
    default y

endif
```

## boards/shields/helipad/Kconfig.shield
```kconfig
# Copyright (c) 2020 The ZMK Contributors
# SPDX-License-Identifier: MIT

config SHIELD_HELIPAD_LEFT
    def_bool $(shields_list_contains,helipad_left)

config SHIELD_HELIPADX_RIGHT
    def_bool $(shields_list_contains,helipad_right)
```
